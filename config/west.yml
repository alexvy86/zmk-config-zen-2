## config/west.yml
```yaml
# NOTES: using urob's fork for:
# - Andrzej's change for hold-on-release to work with tap-preferred hold-taps.
# - Cem Aksoylar's display and battery tweaks.
manifest:
  remotes:
    - name: urob
      url-base: https://github.com/urob
  projects:
    - name: zmk
      remote: urob
      revision: main
      import: app/west.yml
  self:
    path: config
```
